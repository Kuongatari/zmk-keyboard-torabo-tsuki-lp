## config/west.yml
```yaml
manifest:
  remotes:
    - name: zmkfirmware
      url-base: https://github.com/zmkfirmware 
      - name: tak-2025
      url-base: https://github.com/tak-2025
  projects:
    - name: zmk    - name: zmk
      remote: tak-2025
      revision: dev
      import: app/west.yml
    - name: torabo-tsuki_ext_FW
      remote: tak-2025
      revision: main
  self:
    path: config
```
